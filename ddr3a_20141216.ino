//arduino code for ddr3a rdimm 4g spd programming 
//with serial number write automation
//arduino receives a serial number from PC in format like 0xFFFF, 2 bytes
//integrated it into original binary and then programming it
//finally a 'P'(indicates "PASS") in ASCII will be sent to PC.
//spd byte offset 0x7a-0x7d is serial number defined by jedec

#include <Wire.h>

const byte SPD_I2C_ADD = 0x57;  //0xAE upper 7bit, for eeprom read write
const int led = 13;
byte temp; // for temp stores byte read from spd

byte spd[16][16] = { 
  {0x91, 0x10, 0x0b, 0x01, 0x04, 0x19, 0x00, 0x09, 0x0b, 0x11, 0x01, 0x08, 0x0a, 0x00, 0xfc, 0x00},
  {0x69, 0x78, 0x69, 0x30, 0x69, 0x11, 0x18, 0x81, 0x00, 0x05, 0x3c, 0x3c, 0x00, 0xf0, 0x83, 0x01},
  {0x80, 0x00, 0x00, 0x00, 0x00, 0x00, 0x00, 0x00, 0x00, 0x88, 0x00, 0x00, 0x00, 0x00, 0x00, 0x00},
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  {0x00, 0x00, 0x00, 0x00, 0x00, 0x00, 0x00, 0x00, 0x00, 0x00, 0x00, 0x00, 0x00, 0x00, 0x00, 0x00}
};

void setup()
{
    Wire.begin(); 
    Serial.begin(9600);  
    pinMode(led, OUTPUT);  //use LED as programming state indicator
}

void loop()
{
    /*-------wait for 2 bytes via serial----------*/
    while (Serial.available() != 2){ ; }
    spd[7][12] = Serial.read();
    spd[7][13] = Serial.read();
  
    /*---------------write data to SPD------------*/
    for(byte i = 0; i <= 15; i++){
        Wire.beginTransmission(SPD_I2C_ADD); 
        Wire.write( 16 * i );
        for( byte j = 0; j <= 15; j++)
            Wire.write(spd[i][j]);  // sends one byte  
        Wire.endTransmission();    // stop transmitting
        delay(5);         //wait 5ms before next start
    }
    
    /*----read from SPD, compare with write value------*/
    
    for(unsigned int a= 0; a< 16; a++){
        for(unsigned int b= 0; b< 16; b++){
            temp = readi2c((int) SPD_I2C_ADD, 16*a+b);
            if (temp != spd[a][b]){
                Serial.print("spd programming fail!!");
                led_blinking();
            }
        }
    }
    
    /*-----send 'P' when finished-----------------*/
    delay(1000);    //create a time gap
    Serial.print('P');

}
/*--------------------------end of loop------------------------------------------------*/
/*-------------------------------------------------------------------------------------*/

byte readi2c(int deviceaddress, unsigned int byte_address)
{
    byte rdata = 0xFF;
    Wire.beginTransmission(deviceaddress);
    Wire.write((int)byte_address);   
    Wire.endTransmission();
    Wire.requestFrom(deviceaddress,1);
    if (Wire.available()) rdata = Wire.read();
    return rdata;
}

void led_blinking()
{
    Serial.print("something is wrong when validating, check it!\n");
    while (true){
        digitalWrite(led, HIGH);
        delay(500);
        digitalWrite(led, LOW);
        delay(500);
    }
}

/* EOF */
