

#include <Wire.h>

const byte SPD_I2C_ADD = 0x50;  //0xAE upper 7bit, for eeprom read write
const int led = 13;
byte temp; // for temp stores byte read from spd

byte spd[256] = { 
0x02, 0x03, 0x00, 0xb1, 0x04, 0x04, 0x00, 0x00, 0x47, 0x45, 0x4e, 0x39, 0x20, 0x31, 0x78, 0x34,
0x20, 0x4c, 0x46, 0x46, 0x20, 0x42, 0x50, 0x33, 0x20, 0x20, 0x20, 0x20, 0x02, 0x01, 0x00, 0x00,
0x00, 0x01, 0x04, 0x08, 0x01, 0x02, 0x03, 0x04, 0x00, 0x00, 0x05, 0x06, 0x07, 0x08, 0x00, 0x00,
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0x00, 0x00, 0x00, 0x00, 0x00, 0x00, 0x00, 0x00, 0x00, 0x00, 0x00, 0x00, 0x00, 0x00, 0x00, 0x00
};

void setup()
{
    Wire.begin(); 
    Serial.begin(9600);  
    pinMode(led, OUTPUT);  //use LED as programming state indicator
}

void loop()
{
    /*-------wait for 2 bytes via serial----------*/
//    while (Serial.available() != 2){ ; }
//    spd[7][12] = Serial.read();
//    spd[7][13] = Serial.read();
  
    /*---------------write data to SPD------------*/
    for(int i = 0; i <= 255; i++){
        
        Wire.beginTransmission(SPD_I2C_ADD); 
        Wire.write( byte(i) );

        Wire.write(spd[i]);  // sends one byte  


        Wire.endTransmission();    // stop transmitting
//        Serial.print(spd[i], HEX);
//        Serial.print("\t");
        delay(5);         //wait 5ms before next start
    }
    Serial.print("\n");

    
    /*----read from SPD, compare with write value------*/
    

        for(unsigned int b= 0; b< 256; b++){
          
            temp = readi2c((int) SPD_I2C_ADD, byte(b));
//            Serial.print(temp, HEX);
//            Serial.print("\t");
            if (temp != spd[b]){
                Serial.print("NG!NG!NG!");
                led_blinking();
            }
        }
    Serial.print("\nPASS!\n");
    
    /*-----send 'P' when finished-----------------*/
    delay(1000);    //create a time gap
    while(true);
//    Serial.print('P');

}
/*--------------------------end of loop------------------------------------------------*/
/*-------------------------------------------------------------------------------------*/

byte readi2c(int deviceaddress, unsigned int byte_address)
{
    byte rdata = 0xFF;
    Wire.beginTransmission(deviceaddress);
    Wire.write((int)byte_address);   
    Wire.endTransmission();
    Wire.requestFrom(deviceaddress,1);
    if (Wire.available()) rdata = Wire.read();
    return rdata;
}

void led_blinking()
{
    Serial.print("something is wrong when validating, check it!\n");
    while (true){
        digitalWrite(led, HIGH);
        delay(500);
        digitalWrite(led, LOW);
        delay(500);
    }
}

/* EOF */
